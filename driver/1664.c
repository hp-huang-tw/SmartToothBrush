#include "stdio.h"
#include "1664.h"


/* 模擬顯存 */

//unsigned short int DISPLAY_RAM[16][4] = {
//{0xFFFF,0xFFFF,0xFFFF,0xFFFF},
//{0xFFFF,0xFFFF,0xFFFF,0xFFFF},
//{0xFFFF,0xFFFF,0xFFFF,0xFFFF},
//{0xFFFF,0xFFFF,0xFFFF,0xFFFF},
//{0xFFFF,0xFFFF,0xFFFF,0xFFFF},
//{0xFFFF,0xFFFF,0xFFFF,0xFFFF},
//{0xFFFF,0xFFFF,0xFFFF,0xFFFF},
//{0xFFFF,0xFFFF,0xFFFF,0xFFFF},
//{0xFFFF,0xFFFF,0xFFFF,0xFFFF},
//{0xFFFF,0xFFFF,0xFFFF,0xFFFF},
//{0xFFFF,0xFFFF,0xFFFF,0xFFFF},
//{0xFFFF,0xFFFF,0xFFFF,0xFFFF},
//{0xFFFF,0xFFFF,0xFFFF,0xFFFF},
//{0xFFFF,0xFFFF,0xFFFF,0xFFFF},
//{0xFFFF,0xFFFF,0xFFFF,0xFFFF},
//{0xFFFF,0xFFFF,0xFFFF,0xFFFF}
//};



unsigned short int DISPLAY_RAM[16][10] = {
{0xFFFF,0xFFFF,0xFFFF,0xFFFF,0xFFFF,0xFFFF,0xFFFF,0xFFFF,0xFFFF,0xFFFF},
{0xFFFF,0xFFFF,0xFFFF,0xFFFF,0xFFFF,0xFFFF,0xFFFF,0xFFFF,0xFFFF,0xFFFF},
{0xFFFF,0xFFFF,0xFFFF,0xFFFF,0xFFFF,0xFFFF,0xFFFF,0xFFFF,0xFFFF,0xFFFF},
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{0xFFFF,0xFFFF,0xFFFF,0xFFFF,0xFFFF,0xFFFF,0xFFFF,0xFFFF,0xFFFF,0xFFFF}
};

//unsigned short int DISPLAY_RAM[16][8] = {
//{0xFFFF,0xFFFF,0xFFFF,0xFFFF,0xFFFF,0xFFFF,0xFFFF,0xFFFF},
//{0xFFFF,0xFFFF,0xFFFF,0xFFFF,0xFFFF,0xFFFF,0xFFFF,0xFFFF},
//{0xFFFF,0xFFFF,0xFFFF,0xFFFF,0xFFFF,0xFFFF,0xFFFF,0xFFFF},
//{0xFFFF,0xFFFF,0xFFFF,0xFFFF,0xFFFF,0xFFFF,0xFFFF,0xFFFF},
//{0xFFFF,0xFFFF,0xFFFF,0xFFFF,0xFFFF,0xFFFF,0xFFFF,0xFFFF},
//{0xFFFF,0xFFFF,0xFFFF,0xFFFF,0xFFFF,0xFFFF,0xFFFF,0xFFFF},
//{0xFFFF,0xFFFF,0xFFFF,0xFFFF,0xFFFF,0xFFFF,0xFFFF,0xFFFF},
//{0xFFFF,0xFFFF,0xFFFF,0xFFFF,0xFFFF,0xFFFF,0xFFFF,0xFFFF},
//{0xFFFF,0xFFFF,0xFFFF,0xFFFF,0xFFFF,0xFFFF,0xFFFF,0xFFFF},
//{0xFFFF,0xFFFF,0xFFFF,0xFFFF,0xFFFF,0xFFFF,0xFFFF,0xFFFF},
//{0xFFFF,0xFFFF,0xFFFF,0xFFFF,0xFFFF,0xFFFF,0xFFFF,0xFFFF},
//{0xFFFF,0xFFFF,0xFFFF,0xFFFF,0xFFFF,0xFFFF,0xFFFF,0xFFFF},
//{0xFFFF,0xFFFF,0xFFFF,0xFFFF,0xFFFF,0xFFFF,0xFFFF,0xFFFF},
//{0xFFFF,0xFFFF,0xFFFF,0xFFFF,0xFFFF,0xFFFF,0xFFFF,0xFFFF},
//{0xFFFF,0xFFFF,0xFFFF,0xFFFF,0xFFFF,0xFFFF,0xFFFF,0xFFFF},
//{0xFFFF,0xFFFF,0xFFFF,0xFFFF,0xFFFF,0xFFFF,0xFFFF,0xFFFF}
//};








/*
 * void LedDisplay_ON(void)
 */
void LedDisplay_ON(void)
{
	GPIO_ResetBits(GPIOB, GPIO_Pin_7);	 //enable
}

/*
 * void LedDisplay_OFF(void)
 */
void LedDisplay_OFF(void)
{
	GPIO_SetBits(GPIOB, GPIO_Pin_7);  //disable
}

/*
 * void LedDisplay_OutPut(void)
 */
void LedDisplay_OutPut(void)
{
	GPIO_ResetBits(GPIOB, GPIO_Pin_4); //LT(SHCP) clock準備拉起
	GPIO_SetBits(GPIOB, GPIO_Pin_4);   //LT(SHCP) clock拉起
}






/*
 * void Senddata(unsigned short int xdata)
 */
void Senddata(unsigned short int xdata)
{
	SPI_I2S_SendData(SPI4, xdata);
	while (SPI_I2S_GetFlagStatus(SPI4, SPI_I2S_FLAG_RXNE) == RESET);
}





/*
 * void LedDisplay(void)
 */
void LedDisplay(void)	 //當經過526uS則會產生一次timer中斷，中斷程式會呼叫此函示
{
	static unsigned char i = 0;
	unsigned int x=0, y=0, output=0;
	
	LedDisplay_OFF();//關顯示
	GPIO_ResetBits(GPIOB, GPIO_Pin_4);	  //先clear
	GPIO_ResetBits(GPIOB, GPIO_Pin_7);	  //先clear
	
	
	Senddata(DISPLAY_RAM[i][0]);//送出數據
	Senddata(DISPLAY_RAM[i][1]);//送出數據
	Senddata(DISPLAY_RAM[i][2]);//送出數據
	Senddata(DISPLAY_RAM[i][3]);//送出數據
	Senddata(0xffff);//送出數據
	Senddata(DISPLAY_RAM[i][4]);//送出數據
	Senddata(DISPLAY_RAM[i][5]);//送出數據
	Senddata(DISPLAY_RAM[i][6]);//送出數據
	Senddata(DISPLAY_RAM[i][7]);//送出數據

	//Senddata(DISPLAY_RAM[i][10]);//送出數據	
	//i |= 0x0030;//0x0    0x1     0x2    0x3     0x4    0x5
	x = i << 8;   //0x0    0x100   0x200  0x300   0x400  0x500   PC8
	x &= 0x0100;  //0x0    0x100   0x0    0x100   0x0    0x0100
	y = i << 10;  //0x0    0x400   0x800  0xC00   0x1000 0x1400
	y &= 0x3800;  //0      0x0     0x800  0x800   0x1000 0x1000  PC11~13
	
	output |= x;  //0      0x100   0x0    0x100 
	output |= y;  //0      0x500   0x800  0x900 
	
	GPIO_Write(GPIOC, output);//輸出行
	LedDisplay_OutPut();//緩存鎖
	LedDisplay_ON();//開顯示
	
	i ++;
	//i &= 0xffcf;

	if (i > 15)
	{
		i = 0;
	}
}






/*
 * void LedDisplay_WriteDot(unsigned char x, unsigned char y, unsigned char color)
 */
void LedDisplay_WriteDot(unsigned char x, unsigned char y, unsigned char color)
{
	//printf("x = %c, y = %c\r\n", x, y);
	if (x < LED_X_MAX && y < LED_Y_MAX)// 判斷是否在螢幕上操作
	{
		if (x < 16){
			if (color){
				DISPLAY_RAM[y][0] |= (1 << (15 - x));
			}else			{
				DISPLAY_RAM[y][0] &= ~(1 << (15 - x));
			}
			
		}
		else if (x < 32)
		{
			x -= 16;
			
			if (color)
			{
				DISPLAY_RAM[y][1] |= (1 << (15 - x));
			}else
			{
				DISPLAY_RAM[y][1] &= ~(1 << (15 - x));
			}
			
		}
		
		else if (x < 48)
		{
			x -= 32;
			
			if (color)
			{
				DISPLAY_RAM[y][2] |= (1 << (15 - x));
			}else
			{
				DISPLAY_RAM[y][2] &= ~(1 << (15 - x));
			}

		}else if (x < 64)
		{
			x -= 48;
			
			if (color)
			{
				DISPLAY_RAM[y][3] |= (1 << (15 - x));
			}else
			{
				DISPLAY_RAM[y][3] &= ~(1 << (15 - x));
			}
		}///*
		else if (x < 80)
		{
			x -= 64;
			
			if (color)
			{
				DISPLAY_RAM[y][4] |= (1 << (15 - x));
			}else
			{
				DISPLAY_RAM[y][4] &= ~(1 << (15 - x));
			}
		}else if (x < 96)
		{
			x -= 80;
			
			if (color)
			{
				DISPLAY_RAM[y][5] |= (1 << (15 - x));
			}else
			{
				DISPLAY_RAM[y][5] &= ~(1 << (15 - x));
			}
		}else if (x < 112)
		{
			x -= 96;
			
			if (color)
			{
				DISPLAY_RAM[y][6] |= (1 << (15 - x));
			}else
			{
				DISPLAY_RAM[y][6] &= ~(1 << (15 - x));
			}
		}///*
		else if (x < 128)
		{
			x -= 112;
			
			if (color)
			{
				DISPLAY_RAM[y][7] |= (1 << (15 - x));
			}else
			{
				DISPLAY_RAM[y][7] &= ~(1 << (15 - x));
			}
		}//*/
		
	}
}

